## Kconfig
```kconfig
config ZEPHLETS
    bool "Isolated zephlet system"
    select ZBUS
    select ZBUS_ASYNC_LISTENER
    select NANOPB

if ZEPHLETS

config ZEPHLET_MAX_INSTANCES
    int "Maximum number of zephlet instances"
    default 16
    help
      Upper bound on the number of zephlet instances resolved by
      `STRUCT_SECTION_FOREACH(zephlet, ...)` at runtime. Used to size
      the SYS_INIT init-priority ordering buffer.

config ZEPHLETS_COORD
    bool "Coordinator framework"
    help
      Step-based workflow primitive for orchestrating multi-zephlet
      flows on a dedicated workqueue, with optional zbus-event await
      and bounded timeout. See zephlet_coord.h for the public surface.

if ZEPHLETS_COORD

config ZEPHLETS_COORD_STACK_SIZE
    int "Stack size for the shared coordinator workqueue"
    default 2048
    help
      Stack size in bytes for the zephlet_coord_workq thread shared by
      all coordinators in the application.

config ZEPHLETS_COORD_PRIORITY
    int "Priority for the shared coordinator workqueue"
    default 10
    help
      Thread priority for the zephlet_coord_workq thread. Coordinator
      steps tend to be longer-running than typical k_work, so they get
      their own thread rather than the system workqueue.

config ZEPHLETS_COORD_ASYNC_ZBUS_TIMEOUT
    int "Timeout for the async API of zephlet_coord when claiming channels"
    default 25
    help
      Timeout in milliseconds for the async API of zephlet_coord when
      claiming channels. This is the timeout for the underlying
      zbus_chan_add_obs and zbus_chan_rm_obs calls to complete, 
      both of which can fail if the channel is already claimed by a 
      third party.

endif # ZEPHLETS_COORD

config ZEPHLETS_COAP
    bool "CoAP frontend for zephlets"
    select NETWORKING
    select NET_UDP
    select NET_SOCKETS
    select COAP
    select COAP_SERVER
    select COAP_URI_WILDCARD
    select COAP_EXTENDED_OPTIONS_LEN
    help
      Expose opted-in zephlets over CoAP (UDP). Extended option length
      is required so URI-Path segments up to
      `CONFIG_ZEPHLETS_COAP_MAX_SEGMENT_LEN` bytes survive
      `coap_find_options` without truncation.

config COAP_EXTENDED_OPTIONS_LEN_VALUE
    # Leave headroom above CONFIG_ZEPHLETS_COAP_MAX_SEGMENT_LEN so the
    # CoAP parser accepts segments slightly longer than what zephlet
    # handlers will copy out; the handler then surfaces 4.04 for the
    # overflow case. A flat 32 here would make the parser reject the
    # frame before the handler ever runs.
    default 64 if ZEPHLETS_COAP

config COAP_SERVER_WELL_KNOWN_CORE
    # The zephlet frontend ships its own `/.well-known/core` handler in
    # `zephlet_coap_discovery.c` that filters out resources tagged
    # `ZEPHLET_COAP_HIDDEN` (the wildcards of non-discoverable services)
    # before delegating to Zephyr's `coap_well_known_core_get_len`.
    # Zephyr's stock intercept would otherwise short-circuit before our
    # resource fires and leak the hidden wildcards into the enumeration.
    default n if ZEPHLETS_COAP

config COAP_SERVER_MESSAGE_SIZE
    # The discovery handlers (`/.well-known/core`, `/zlet/<type>/instances`,
    # `/zlet/<type>/apis`) all build RFC 6690 link-format payloads whose
    # total length scales with the registered resource set. Default 256
    # truncates once a handful of discoverable types accumulate; bump to
    # 1024 so the response packet builder has headroom.
    default 1024 if ZEPHLETS_COAP

config ZEPHLETS_COAP_DTLS
    bool "DTLS (PSK) for the CoAP frontend"
    depends on ZEPHLETS_COAP
    select NET_SOCKETS_SOCKOPT_TLS
    select NET_SOCKETS_ENABLE_DTLS
    select TLS_CREDENTIALS
    select MBEDTLS
    select MBEDTLS_ENABLE_HEAP
    select MBEDTLS_CIPHERSUITE_TLS_PSK_WITH_AES_128_GCM_SHA256
    help
      Serve the CoAP frontend over DTLS (CoAPS) on
      ZEPHLETS_COAP_SECURE_PORT instead of plain UDP 5683, authenticated
      with a pre-shared key. The integrator supplies the PSK identity and
      key via ZEPHLETS_COAP_DTLS_PSK_IDENTITY / _KEY and the security tag
      via ZEPHLETS_COAP_DTLS_SEC_TAG; no key material ships in the
      framework.

if ZEPHLETS_COAP_DTLS

config ZEPHLETS_COAP_SECURE_PORT
    int "CoAPS (DTLS) UDP port"
    default 5684
    help
      UDP port the DTLS-wrapped CoAP service binds. RFC 7252 registers
      5684 for the "coaps" scheme.

config ZEPHLETS_COAP_DTLS_SEC_TAG
    int "TLS credential security tag for the CoAPS PSK"
    default 1
    help
      Security tag the frontend registers the PSK under and passes to
      COAPS_SERVICE_DEFINE. Must not collide with other tls_credential
      security tags the application registers.

config ZEPHLETS_COAP_DTLS_PSK_IDENTITY
    string "CoAPS DTLS PSK identity"
    default ""
    help
      PSK identity presented during the DTLS handshake. Integrator-
      supplied; empty by default so a misconfigured build is caught at
      credential registration rather than shipping a guessable identity.

config ZEPHLETS_COAP_DTLS_PSK_KEY
    string "CoAPS DTLS PSK key bytes"
    default ""
    help
      Pre-shared key bytes used for the DTLS handshake. Integrator-
      supplied through an overlay or secret; key material is never
      committed in the framework tree.

endif # ZEPHLETS_COAP_DTLS

config MBEDTLS_HEAP_SIZE
    # The stock mbedTLS heap is too small for a DTLS-PSK handshake. Size it
    # for the CoAPS server out of the box (still integrator-overridable).
    default 60000 if ZEPHLETS_COAP_DTLS

config NET_SOCKETS_TLS_MAX_CONTEXTS
    # One context for the listening DTLS socket plus headroom for a few
    # concurrent client sessions; the stock default of 1 is too few.
    default 4 if ZEPHLETS_COAP_DTLS

config ZEPHLETS_COAP_MAX_SEGMENT_LEN
    int "Maximum length of a CoAP URI segment under /zlet/"
    depends on ZEPHLETS_COAP
    default 32
    help
      Stack-buffer size (excluding the null terminator) for each URI
      segment that a zephlet's CoAP handler copies out of the request's
      `COAP_OPTION_URI_PATH` options. Inbound segments longer than this
      are rejected with 4.04. The reasonable floor is the longest
      `name` used in `ZEPHLET_NEW(...)`; the floor for method segments
      is the longest rpc name declared in any opted-in `.proto`.

config ZEPHLETS_COAP_MAX_URI_SEGMENTS
    int "Maximum number of CoAP URI path segments per request"
    depends on ZEPHLETS_COAP
    default 8
    help
      Stack-array size handed to `coap_find_options` when a zephlet's
      CoAP handler decodes a request's URI path. RPC dispatch needs
      4 segments (`zlet/<type>/<instance>/<method>`); the
      `events/stats` form needs 5. The default leaves headroom for
      future path shapes; requests with more segments than this are
      rejected with 4.04.

config ZEPHLETS_COAP_DISCOVERY_BUF_SIZE
    int "Output buffer for the per-type discovery handlers (bytes)"
    depends on ZEPHLETS_COAP
    default 512
    help
      Stack-buffer size each codegen-emitted `/zlet/<type>/instances`
      handler uses to assemble its RFC 6690 link-format response. The
      handler walks `STRUCT_SECTION_FOREACH(zephlet, z)` filtered by
      `z->api == &<type>_api` and snprintfs one link per match. If the
      cumulative output exceeds this buffer, the handler responds 4.13
      Request Entity Too Large and logs a warning naming the configured
      size; operators raise this Kconfig until the per-type instance
      list fits. The `/apis` handler does not consume this buffer — its
      response is a fully codegen-baked static const string blob.

config ZEPHLETS_COAP_CMD_TIMEOUT_MS
    int "Timeout for publishing a CoAP-originated call onto the command channel (ms)"
    depends on ZEPHLETS_COAP
    default 100
    help
      Upper bound the CoAP handler is willing to wait for
      `zbus_chan_pub()` on a zephlet's `command` channel before
      surfacing 5.03 to the caller. Only the channel mutex
      contention is relevant — the sync listener runs in the
      publisher's own thread, so this never times out a handler
      that is making forward progress.

config ZEPHLETS_COAP_MAX_OBSERVERS
    int "Maximum number of concurrent CoAP Observe subscribers"
    depends on ZEPHLETS_COAP
    default ZEPHLET_MAX_INSTANCES
    help
      Size of the global pool of CoAP Observe subscriber records shared
      across every opted-in zephlet instance. Each record is allocated
      from a k_mem_slab when a client subscribes (GET carrying the Observe
      option) and freed on deregister; it holds the subscriber's endpoint
      address and token. A subscribe that finds no free record is answered
      5.03 Service Unavailable. The default tracks
      CONFIG_ZEPHLET_MAX_INSTANCES (roughly one subscriber per instance);
      raise it when clients fan out with several observers per instance,
      lower it to bound RAM.

module = ZEPHLET
module-str = zephlet
source "subsys/logging/Kconfig.template.log_config"

endif # ZEPHLETS
```

## codegen/zephyr_zephlet_template/template/{{ zephlet_name_lower }}/Kconfig.jinja
```kconfig
config ZEPHLET_{{ zephlet_name_upper }}
    bool "{{ zephlet_name }} Zephlet Module"
    select NANOPB
    select ZBUS
    select ZBUS_ASYNC_LISTENER
    help
      Enable this option to include the {{ zephlet_name }} Zephlet Module in the build.
      {{ zephlet_description }}.

if(ZEPHLET_{{ zephlet_name_upper }})

module = ZEPHLET_{{ zephlet_name_upper }}
module-str = zlet_{{ zephlet_name_lower }}
source "subsys/logging/Kconfig.template.log_config"

endif
```

## tests/coap_functional/zephlets/silent/Kconfig
```kconfig
config ZEPHLET_SILENT
    bool "Silent zephlet (CoAP functional test fixture)"
    select NANOPB
    select ZBUS
    select ZBUS_ASYNC_LISTENER
    help
      Enable the `silent` zephlet copy used by the CoAP discovery
      functional test. `silent` opts into the CoAP RPC frontend but not
      into discovery, so a `silent_inst` instance is callable yet must
      never appear in `/.well-known/core`. The test asserts that
      asymmetry to prove the `coap_discoverable` proto option gates
      emission.

if ZEPHLET_SILENT

module = ZEPHLET_SILENT
module-str = zlet_silent
source "subsys/logging/Kconfig.template.log_config"

endif
```

## tests/coap_functional/zephlets/tick/Kconfig
```kconfig
config ZEPHLET_TICK
    bool "Tick zephlet (CoAP functional test fixture)"
    select NANOPB
    select ZBUS
    select ZBUS_ASYNC_LISTENER
    help
      Enable the `tick` zephlet copy that the CoAP functional test
      instantiates as `tick_fast`. Mirrors the app's `tick` semantics so
      the dispatch tests exercise a realistic handler.

if ZEPHLET_TICK

module = ZEPHLET_TICK
module-str = zlet_tick
source "subsys/logging/Kconfig.template.log_config"

endif
```

## tests/coap_functional/zephlets/ui/Kconfig
```kconfig
config ZEPHLET_UI
    bool "UI zephlet (CoAP functional test fixture)"
    select NANOPB
    select ZBUS
    select ZBUS_ASYNC_LISTENER
    help
      Enable the `ui` zephlet copy used by the CoAP functional test to
      register a second opted-in type at `/zlet/ui/#`. Lets the test
      exercise the api-mismatch defensive check (`/zlet/ui/tick_fast/...`
      → 4.04).

if ZEPHLET_UI

module = ZEPHLET_UI
module-str = zlet_ui
source "subsys/logging/Kconfig.template.log_config"

endif
```

## tests/coap_translate/testcase.yaml
```yaml
tests:
  zephlet.coap.translate:
    tags: zephlet coap translate
    harness: ztest
    platform_allow:
      - native_sim
      - native_sim/native/64
      - mps2/an385
    timeout: 30
```

## tests/shared/dispatch/testcase.yaml
```yaml
tests:
  zephlet.shared.dispatch:
    tags: zephlet shared dispatch
    harness: ztest
    platform_allow:
      - native_sim
      - native_sim/native/64
    timeout: 30
```
