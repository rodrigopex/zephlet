## CMakeLists.txt
```
cmake_minimum_required(VERSION 3.20.0)

get_filename_component(ZEPHLET_INFRA_ROOT "${CMAKE_CURRENT_SOURCE_DIR}/../.." ABSOLUTE)

set_property(GLOBAL PROPERTY PROTO_FILES_LIST)

# CONFIG_ZEPHLETS_LUA=y (prj.conf) makes the infra module pull in
# frontends/lua/ automatically. lua_zephyr comes from the west manifest.
list(APPEND EXTRA_ZEPHYR_MODULES
    "${ZEPHLET_INFRA_ROOT}"
    "${CMAKE_CURRENT_SOURCE_DIR}/zephlets/probe"
)

find_package(Zephyr REQUIRED HINTS $ENV{ZEPHYR_BASE})

project(zephlet_lua_functional_test)

list(APPEND CMAKE_MODULE_PATH ${ZEPHYR_BASE}/modules/nanopb)
include(nanopb)
set(NANOPB_OPTIONS "--c-style")

get_property(LOCAL_PROTO_FILES_LIST GLOBAL PROPERTY PROTO_FILES_LIST)

# Anchor nanopb output under zephlets/ so each proto lands at
# ${CMAKE_BINARY_DIR}/<type>/<prefix>.pb.h, the path codegen #includes.
set(_saved_csd ${CMAKE_CURRENT_SOURCE_DIR})
set(CMAKE_CURRENT_SOURCE_DIR "${CMAKE_CURRENT_SOURCE_DIR}/zephlets")
zephyr_nanopb_sources(app ${LOCAL_PROTO_FILES_LIST})
set(CMAKE_CURRENT_SOURCE_DIR ${_saved_csd})

target_sources(app PRIVATE src/main.c)

if(CONFIG_ZEPHLETS_LUA)
    # One suite per scenario, chosen in testcase.yaml; main() runs it as
    # ZEPHLET_LUA_SCRIPT(SUITE).
    luaz_add_bytecode_file("scripts/${CONFIG_TEST_LUA_SUITE}.lua")
    target_compile_definitions(app PRIVATE
        SUITE=${CONFIG_TEST_LUA_SUITE}
        SUITE_HEADER="${CONFIG_TEST_LUA_SUITE}_lua_bytecode.h")
endif()
```

## Kconfig
```
config TEST_LUA_SUITE
    string "Lua suite to run"
    default "basic"
    help
      Name of the script under scripts/, without the .lua extension,
      that main() hands to zephlet_lua_coordinate().

config TEST_LUA_BAD_BUFFER
    bool "Start the frontend with a buffer that is not a Lua chunk"
    help
      main() hands zephlet_lua_coordinate() a truncated bytecode header
      instead of the suite's script, so the start fails to load the chunk.

source "Kconfig.zephyr"
```

## prj.conf
```kconfig
CONFIG_ZBUS=y
CONFIG_ZEPHLETS=y
CONFIG_NANOPB=y
CONFIG_ZEPHLET_PROBE=y

CONFIG_LUA=y
CONFIG_LUA_ASYNC=y
CONFIG_LUA_LIBS_ALL=y
CONFIG_ZEPHLETS_LUA=y
# The suite allocates freely (closures, tracebacks); on a 64-bit host Lua
# objects and heap chunks are larger too. Lua starts a cycle once the heap
# reaches 250% of what the last one kept, so with about 60 KB live a 128 KB
# heap runs out first and allocations fail depending on fragmentation. It
# stays under the 262136 bytes a small-only sys_heap (32-bit native_sim)
# allows.
CONFIG_ZEPHLETS_LUA_HEAP_SIZE=245760

# Bursts of events go through the zbus message pool twice: once to the
# forwarding listener, once as a doorbell.
CONFIG_ZBUS_MSG_SUBSCRIBER_NET_BUF_POOL_SIZE=32

# Lua's print() and the suite summary go straight to the console, in order.
CONFIG_LOG=y
CONFIG_LOG_MODE_IMMEDIATE=y
CONFIG_ASSERT=y
CONFIG_BOOT_BANNER=n
CONFIG_THREAD_NAME=y
```

## src/main.c
```c
#include <errno.h>

#include <zephyr/kernel.h>
#include <zephyr/sys/printk.h>

#include "zlet_probe.h"

/**
 * @file
 * @brief Host app for the Lua functional twister target.
 *
 * Three `probe` instances: probe_a and probe_b are the event sources the
 * suites connect to, probe_idle is never connected. main() hands the suite
 * chosen by CONFIG_TEST_LUA_SUITE to zephlet_lua_coordinate(); a second
 * thread then tries to start the frontend again, which must be refused.
 */

static struct probe_config probe_a_cfg;
static struct probe_data probe_a_data;
ZEPHLET_NEW(probe, probe_a, &probe_a_cfg, &probe_a_data, probe_init_fn);

static struct probe_config probe_b_cfg;
static struct probe_data probe_b_data;
ZEPHLET_NEW(probe, probe_b, &probe_b_cfg, &probe_b_data, probe_init_fn);

static struct probe_config probe_idle_cfg;
static struct probe_data probe_idle_data;
ZEPHLET_NEW(probe, probe_idle, &probe_idle_cfg, &probe_idle_data, probe_init_fn);

#if defined(CONFIG_ZEPHLETS_LUA)
#include <zephlet_lua.h>

/* scripts/<CONFIG_TEST_LUA_SUITE>.lua, precompiled. */
#include SUITE_HEADER

static void second_run(void *p1, void *p2, void *p3)
{
	ARG_UNUSED(p1);
	ARG_UNUSED(p2);
	ARG_UNUSED(p3);

	int rc = zephlet_lua_coordinate(ZEPHLET_LUA_SCRIPT(SUITE));

	printk("second zephlet_lua_coordinate(): %s\n",
	       (rc == -EALREADY) ? "EALREADY" : "unexpected");
}

K_THREAD_DEFINE(second_run_tid, 1024, second_run, NULL, NULL, NULL, 5, 0, 200);

static const char *rc_name(int rc)
{
	switch (rc) {
	case -EINVAL:
		return "EINVAL";
	case -ENOEXEC:
		return "ENOEXEC";
	case -ENOMEM:
		return "ENOMEM";
	case -EFAULT:
		return "EFAULT";
	default:
		return "unexpected";
	}
}

#if defined(CONFIG_TEST_LUA_BAD_BUFFER)
/* A bytecode signature with nothing after it. */
static const char not_lua[] = "\x1bLua";
#endif

/* Every event staging turned away or overwrote, across all instances: the
 * drops counted after the seal and the overwrites before it. */
static long staged_drops(void)
{
	long n = 0;

	STRUCT_SECTION_FOREACH(zephlet_lua_instance, inst) {
		n += (long)atomic_get(&inst->stats.staged_drop);
		n += (long)atomic_get(&inst->preseal_drop);
	}

	return n;
}

int main(void)
{
#if defined(CONFIG_TEST_LUA_BAD_BUFFER)
	int rc = zephlet_lua_coordinate(not_lua, sizeof(not_lua) - 1U, "=not_lua");
#else
	int rc = zephlet_lua_coordinate(ZEPHLET_LUA_SCRIPT(SUITE));
#endif
	struct probe_burst burst = {.count = 2 * CONFIG_ZEPHLETS_LUA_STAGING_DEPTH};
	long before;

	printk("zephlet_lua_coordinate() returned %s\n", rc_name(rc));

	/* Once it has returned, nothing empties staging: the listeners must stop
	 * staging rather than fill it and count drops forever. */
	before = staged_drops();
	(void)probe_burst(&probe_a, &burst, K_MSEC(100));
	k_msleep(50);
	printk("after the frontend stopped: %ld new staged drops\n", staged_drops() - before);
	return 0;
}
#else
int main(void)
{
	printk("lua frontend disabled\n");
	return 0;
}
#endif
```
