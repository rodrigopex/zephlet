## CMakeLists.txt
```
cmake_minimum_required(VERSION 3.20.0)

get_filename_component(ZEPHLET_INFRA_ROOT "${CMAKE_CURRENT_SOURCE_DIR}/../.." ABSOLUTE)

set_property(GLOBAL PROPERTY PROTO_FILES_LIST)

list(APPEND EXTRA_ZEPHYR_MODULES
    "${ZEPHLET_INFRA_ROOT}"
    "${CMAKE_CURRENT_SOURCE_DIR}/zephlets/tick"
    "${CMAKE_CURRENT_SOURCE_DIR}/zephlets/ui"
    "${CMAKE_CURRENT_SOURCE_DIR}/zephlets/silent"
    "${CMAKE_CURRENT_SOURCE_DIR}/zephlets/blob"
)

find_package(Zephyr REQUIRED HINTS $ENV{ZEPHYR_BASE})

project(zephlet_coap_functional_test)

list(APPEND CMAKE_MODULE_PATH ${ZEPHYR_BASE}/modules/nanopb)
include(nanopb)
set(NANOPB_OPTIONS "--c-style")

get_property(LOCAL_PROTO_FILES_LIST GLOBAL PROPERTY PROTO_FILES_LIST)

# Anchor nanopb output under tests/coap_functional/zephlets/ so each
# proto lands at ${CMAKE_BINARY_DIR}/<type>/<prefix>.pb.h, matching the
# `#include "<type>/<prefix>.pb.h"` pattern that codegen emits.
set(_saved_csd ${CMAKE_CURRENT_SOURCE_DIR})
set(CMAKE_CURRENT_SOURCE_DIR "${CMAKE_CURRENT_SOURCE_DIR}/zephlets")
zephyr_nanopb_sources(app ${LOCAL_PROTO_FILES_LIST})
set(CMAKE_CURRENT_SOURCE_DIR ${_saved_csd})

target_sources(app PRIVATE src/main.c)
```

## prj.conf
```kconfig
CONFIG_ZBUS=y
CONFIG_ZEPHLETS=y
CONFIG_ZEPHLETS_COAP=y
CONFIG_NANOPB=y

CONFIG_ZEPHLET_TICK=y
CONFIG_ZEPHLET_UI=y
CONFIG_ZEPHLET_SILENT=y

CONFIG_LOG=y
CONFIG_ASSERT=y
CONFIG_TEST_RANDOM_GENERATOR=y

# Offloaded sockets driver: the Zephyr binary forwards socket calls to
# the host BSD stack via the native simulator. The pytest fixture
# reaches the guest CoAP server at 127.0.0.1 on CONFIG_ZEPHLETS_COAP_PORT,
# which testcase.yaml sets per scenario, with no TAP setup,
# no root, and no host-side networking configuration. Works the same
# under bare Linux, Docker, and Colima.
CONFIG_NET_DRIVERS=y
CONFIG_NET_SOCKETS=y
CONFIG_NET_SOCKETS_OFFLOAD=y
CONFIG_NET_NATIVE_OFFLOADED_SOCKETS=y
CONFIG_NET_IPV6_DAD=n

CONFIG_COAP=y
CONFIG_COAP_SERVER=y
CONFIG_COAP_URI_WILDCARD=y

CONFIG_MAIN_STACK_SIZE=2048
```

## src/main.c
```c
#include <errno.h>

#include <zephyr/kernel.h>
#include <zephyr/logging/log.h>

#if defined(CONFIG_NET_CONNECTION_MANAGER)
#include <zephyr/net/net_if.h>
#include <zephyr/net/net_ip.h>
#endif

#include "zlet_silent.h"
#include "zlet_tick.h"
#include "zlet_ui.h"
#if defined(CONFIG_ZEPHLET_BLOB)
#include "zlet_blob.h"
#endif

LOG_MODULE_REGISTER(zlet_coap_functional, LOG_LEVEL_INF);

/**
 * @file
 * @brief Host app for the CoAP functional twister target.
 *
 * Instantiates one `tick`, one `ui`, and one `silent` zephlet so the
 * codegen-emitted per-type CoAP resources have live targets. `tick` and
 * `ui` opt into discovery; `silent` exposes RPCs but stays absent from
 * `/.well-known/core`, which the discovery test asserts. The CoAP
 * service + resources are registered automatically via the frontend's
 * `COAP_SERVICE_DEFINE` and each opted-in zephlet's
 * `COAP_RESOURCE_DEFINE` — there is no inline CoAP setup here.
 */

static struct tick_config tick_fast_cfg = {
	.duration_ms = 100,
	.period_ms = 100,
};
static struct tick_data tick_fast_data;
ZEPHLET_NEW(tick, tick_fast, &tick_fast_cfg, &tick_fast_data, tick_init_fn);

/* Second `tick` instance — exercises the multi-instance case of the
 * `/zlet/tick/instances` runtime walk. */
static struct tick_config tick_slow_cfg = {
	.duration_ms = 500,
	.period_ms = 500,
};
static struct tick_data tick_slow_data;
ZEPHLET_NEW(tick, tick_slow, &tick_slow_cfg, &tick_slow_data, tick_init_fn);

static struct ui_config ui_main_cfg = {
	.blink_period_ms = 250,
};
static struct ui_data ui_main_data;
ZEPHLET_NEW(ui, ui_main, &ui_main_cfg, &ui_main_data, ui_init_fn);

static struct silent_config silent_inst_cfg = {
	.nothing = 0,
};
static struct silent_data silent_inst_data;
ZEPHLET_NEW(silent, silent_inst, &silent_inst_cfg, &silent_inst_data, silent_init_fn);

#if defined(CONFIG_ZEPHLET_BLOB)
/* Block2 scenario: a read response of 120 bytes, several blocks of 16 */
static struct blob_config blob_inst_cfg = {
	.size = 120,
};
static struct blob_data blob_inst_data;
ZEPHLET_NEW(blob, blob_inst, &blob_inst_cfg, &blob_inst_data, blob_init_fn);
#endif

int main(void)
{
#if defined(CONFIG_ZEPHLETS_COAP_DTLS)
	LOG_INF("zephlet coap functional host up on UDP/%d", CONFIG_ZEPHLETS_COAP_SECURE_PORT);
#else
	LOG_INF("zephlet coap functional host up on UDP/%d", CONFIG_ZEPHLETS_COAP_PORT);
#endif

#if defined(CONFIG_NET_CONNECTION_MANAGER)
	/*
	 * The offloaded-sockets iface never runs DHCP — it forwards socket
	 * calls straight to the host BSD stack. But conn_mgr's L4_CONNECTED
	 * still requires the *Zephyr-side* iface to have L3 readiness (an
	 * IPv4/IPv6 address of its own), same as upstream's conn_mgr_nsos
	 * test: a manual address is enough to let `net cm connect` produce
	 * a real L4_CONNECTED once the connectivity-sim binding clears
	 * dormant.
	 */
	struct net_if *iface = net_if_get_default();
	struct net_in_addr addr;

	net_addr_pton(NET_AF_INET, "192.0.2.1", &addr);
	net_if_ipv4_addr_add(iface, &addr, NET_ADDR_MANUAL, 0);
#endif

	return 0;
}
```
