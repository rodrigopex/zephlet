## tests/coap_functional/zephlets/blob/Kconfig
```kconfig
config ZEPHLET_BLOB
    bool "Blob zephlet (CoAP functional test fixture)"
    select NANOPB
    select ZBUS
    select ZBUS_ASYNC_LISTENER
    help
      Enable the `blob` zephlet used by the Block2 scenario: `read`
      returns a body longer than one block and counts its runs, so the
      test sees how many times a block-wise transfer ran the rpc.

if ZEPHLET_BLOB

module = ZEPHLET_BLOB
module-str = zlet_blob
source "subsys/logging/Kconfig.template.log_config"

endif
```

## tests/deps_functional/testcase.yaml
```yaml
tests:
  zephlet.deps.functional:
    tags: zephlet deps
    harness: ztest
    platform_allow:
      - native_sim
      - native_sim/native/64
      - mps2/an385
    integration_platforms:
      - native_sim
    timeout: 30
```

## tests/deps_functional/zephlets/climate/Kconfig
```kconfig
config ZEPHLET_CLIMATE
    bool "Climate zephlet (dependency test fixture)"
    select NANOPB
    select ZBUS
    select ZBUS_ASYNC_LISTENER
    help
      Enable the `climate` controller zephlet, a consumer that declares
      `(zephlet.requires)` on one temperature sensor and two fans and
      calls them from its `regulate` rpc.

if ZEPHLET_CLIMATE

module = ZEPHLET_CLIMATE
module-str = zlet_climate
source "subsys/logging/Kconfig.template.log_config"

endif
```

## tests/deps_functional/zephlets/fan/Kconfig
```kconfig
config ZEPHLET_FAN
    bool "Fan zephlet (dependency test fixture)"
    select NANOPB
    select ZBUS
    select ZBUS_ASYNC_LISTENER
    help
      Enable the simulated `fan` zephlet, a provider that the `climate`
      fixture requires twice, as its intake and its exhaust.

if ZEPHLET_FAN

module = ZEPHLET_FAN
module-str = zlet_fan
source "subsys/logging/Kconfig.template.log_config"

endif
```

## tests/deps_functional/zephlets/temperature/Kconfig
```kconfig
config ZEPHLET_TEMPERATURE
    bool "Temperature zephlet (dependency test fixture)"
    select NANOPB
    select ZBUS
    select ZBUS_ASYNC_LISTENER
    help
      Enable the simulated `temperature` sensor zephlet, a provider that
      the `climate` fixture requires. Its reading is whatever the test
      last set.

if ZEPHLET_TEMPERATURE

module = ZEPHLET_TEMPERATURE
module-str = zlet_temperature
source "subsys/logging/Kconfig.template.log_config"

endif
```

## tests/lua_functional/zephlets/probe/Kconfig
```kconfig
config ZEPHLET_PROBE
    bool "Probe zephlet (Lua functional test fixture)"
    select NANOPB
    select ZBUS
    select ZBUS_ASYNC_LISTENER
    help
      Enable the `probe` zephlet the Lua functional test drives: its
      config message carries every field shape the Lua conversion
      handles, and its commands emit events and fail on request.

if ZEPHLET_PROBE

module = ZEPHLET_PROBE
module-str = zlet_probe
source "subsys/logging/Kconfig.template.log_config"

endif
```

## tests/shared/coord_unit/testcase.yaml
```yaml
tests:
  zephlet.shared.coord_unit:
    type: unit
    tags: zephlet shared coord
```

## tests/shared/deps_init/testcase.yaml
```yaml
tests:
  zephlet.shared.deps_init:
    tags: zephlet shared deps
    harness: ztest
    platform_allow:
      - native_sim
      - native_sim/native/64
      - mps2/an385
    integration_platforms:
      - native_sim
    timeout: 30
  zephlet.shared.deps_init.shell:
    tags: zephlet shared deps shell
    harness: ztest
    platform_allow:
      - native_sim
      - native_sim/native/64
      - mps2/an385
    integration_platforms:
      - native_sim
    timeout: 30
    extra_configs:
      - CONFIG_ZEPHLETS_SHELL=y
      - CONFIG_SHELL_BACKEND_SERIAL=n
      - CONFIG_SHELL_BACKEND_DUMMY=y
      - CONFIG_SHELL_BACKEND_DUMMY_BUF_SIZE=4096
```

## tests/shell_functional/zephlets/typelab/Kconfig
```kconfig
config ZEPHLET_TYPELAB
    bool "Typelab zephlet (shell functional test fixture)"
    select NANOPB
    select ZBUS
    select ZBUS_ASYNC_LISTENER
    help
      Enable the `typelab` zephlet the shell functional test instantiates
      as `typelab_bench` — one Config field per nanopb scalar type the
      `zlet` shell frontend supports, plus a set_X/get_X rpc pair per
      type, so the dispatch tests exercise every shell parse/print path
      through real `zlet typelab_bench ...` commands, not just the
      couple of scalar types tick/ui happen to use.

if ZEPHLET_TYPELAB

module = ZEPHLET_TYPELAB
module-str = zlet_typelab
source "subsys/logging/Kconfig.template.log_config"

endif
```

## tests/shell_functional/zephlets/ui/Kconfig
```kconfig
config ZEPHLET_UI
    bool "UI zephlet (shell functional test fixture)"
    select NANOPB
    select ZBUS
    select ZBUS_ASYNC_LISTENER
    help
      Enable the `ui` zephlet copy used by the shell functional test to
      register a second type (`ui_main`) alongside `tick_fast`/
      `tick_slow`, so the no-cross-talk assertions cover both
      multi-instance (same type) and multi-type cases.

if ZEPHLET_UI

module = ZEPHLET_UI
module-str = zlet_ui
source "subsys/logging/Kconfig.template.log_config"

endif
```

## tests/shell_macros/testcase.yaml
```yaml
tests:
  zephlet.shell.macros:
    tags: zephlet shell macros
    harness: ztest
    platform_allow:
      - native_sim
      - native_sim/native/64
      - mps2/an385
    timeout: 30
```
